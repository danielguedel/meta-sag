## conf/layer.conf
```bitbake
# We have a conf and classes directory, add to BBPATH
BBPATH .= ":${LAYERDIR}"

# We have recipes-* directories, add to BBFILES
BBFILES += "${LAYERDIR}/recipes-*/*/*.bb \
            ${LAYERDIR}/recipes-*/*/*.bbappend"

BBFILE_COLLECTIONS += "sag sagimx8mx"
BBFILE_PATTERN_sag = "^${LAYERDIR}/"
BBFILE_PRIORITY_sag = "10"
LAYERVERSION_sag = "1"
LAYERSERIES_COMPAT_sag = "rocko sumo zeus"

BBFILE_PATTERN_sagimx8mx = "^${LAYERDIR}/"
BBFILE_PRIORITY_sagimx8mx = "10"
LAYERVERSION_sagimx8mx = "1"
LAYERSERIES_COMPAT_sagimx8mx = "rocko sumo zeus"
```
